## boards/shields/cashew42/Kconfig.defconfig
```kconfig
# Copyright (c) 2026 Satoru NAKAYA
# SPDX-License-Identifier: MIT

if SHIELD_CASHEW42_RIGHT

config ZMK_KEYBOARD_NAME
    default "cashew42"

config ZMK_SPLIT_ROLE_CENTRAL
    default y

endif

if SHIELD_CASHEW42_LEFT || SHIELD_CASHEW42_RIGHT

config ZMK_SPLIT
    default y

if LVGL

config LV_Z_VDB_SIZE
    default 64

config LV_DPI_DEF
    default 148

config LV_Z_BITS_PER_PIXEL
    default 1

choice LV_COLOR_DEPTH
    default LV_COLOR_DEPTH_1
endchoice

endif # LVGL

endif
```

## boards/shields/cashew42/Kconfig.shield
```kconfig
# Copyright (c) 2026 Satoru NAKAYA
# SPDX-License-Identifier: MIT

config SHIELD_CASHEW42_LEFT
   def_bool $(shields_list_contains,cashew42_left)

config SHIELD_CASHEW42_RIGHT
   def_bool $(shields_list_contains,cashew42_right)
```

## config/west.yml
```yaml
manifest:
  remotes:
    - name: zmkfirmware
      url-base: https://github.com/zmkfirmware
    - name: kot149
      url-base: https://github.com/kot149
    - name: tor-nky
      url-base: https://github.com/tor-nky
  projects:
    - name: zmk
      remote: zmkfirmware
      revision: v0.3
      # revision: abb64ba316c29caddc49727ca2cac2f0ed5970c7
      import: app/west.yml
    - name: zmk-layout-shift
      remote: kot149
      revision: v1
      path: modules/zmk-layout-shift
    - name: zmk-rgbled-widget
      url: https://github.com/caksoylar/zmk-rgbled-widget
      revision: v0.3           # MUST match your ZMK version!
      path: modules/zmk-rgbled-widget
    - name: zmk-naginata # ここを追加
      remote: tor-nky
      revision: madake
      path: modules/zmk-naginata
  self:
    path: config
    
```
